;;;;;;;;;;;;;;;;;;;;;;;;;;;;;;;;;;;;;;;;;;;;;;;;;;;;;;;;;;;;;;;;;;;;;;;;;;;;;;;;;
;;                                                                             ;;
;;   32 x 16 character VGA output with UART for Attiny85.                      ;;
;;                                                                             ;;
;;                                                                             ;;
;;   Copyright 2015 Jari Tulilahti                                             ;;
;;                                                                             ;;
;;   All right and deserved                                                    ;;
;;                                                                             ;;
;;   Licensed under the Apache License, Version 2.0 (the "License");           ;;
;;   you may not use this file except in compliance with the License.          ;;
;;   You may obtain a copy of the License at                                   ;;
;;                                                                             ;;
;;       http://www.apache.org/licenses/LICENSE-2.0                            ;;
;;                                                                             ;;
;;   Unless required by applicable law or agreed to in writing, software       ;;
;;   distributed under the License is distributed on an "AS IS" BASIS,         ;;
;;   WITHOUT WARRANTIES OR CONDITIONS OF ANY KIND, either express or implied.  ;;
;;   See the License for the specific language governing permissions and       ;;
;;   limitations under the License.                                            ;;
;;                                                                             ;;
;;;;;;;;;;;;;;;;;;;;;;;;;;;;;;;;;;;;;;;;;;;;;;;;;;;;;;;;;;;;;;;;;;;;;;;;;;;;;;;;;

; Automatically generated file. DO NOT EDIT!

.cseg
.org 0xB00

font:
	.db 0x00, 0xfc, 0xfc, 0xfc, 0xfc, 0xfc, 0xdc, 0xd4
	.db 0xd4, 0xfc, 0xd4, 0xfc, 0xd4, 0xd4, 0x74, 0xdc
	.db 0xd4, 0xd4, 0x0c, 0xf0, 0xfc, 0x54, 0x00, 0xfc
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	.db 0xfc, 0x8c, 0xfc, 0xfc, 0xfc, 0xfc, 0xfc, 0xfc

